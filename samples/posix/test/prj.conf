## CMakeLists.txt
```
# SPDX-License-Identifier: Apache-2.0

cmake_minimum_required(VERSION 3.20.0)

find_package(Zephyr REQUIRED HINTS $ENV{ZEPHYR_BASE})
project(posix_test)

target_sources(app PRIVATE src/main.c)
```

## sample.yaml
```
sample:
  description: posix uname sample
  name: posix uname
common:
  filter: not CONFIG_NATIVE_LIBC
  arch_exclude:
    - nios2
  platform_exclude:
    - native_posix
    - native_posix/native/64
  tags:
    - posix
    - filesystem
    - fatfs
  min_ram: 128
  modules:
    - fatfs
tests:
  useless.posix.fs:
    extra_configs:
      - CONFIG_NEWLIB_LIBC=n
    integration_platforms:
      - qemu_x86
#   portability.posix.fs.newlib:
#     filter: TOOLCHAIN_HAS_NEWLIB == 1
#     arch_exclude:
#       - posix
#     extra_configs:
#       - CONFIG_NEWLIB_LIBC=y
#     integration_platforms:
#       - qemu_x86
#   portability.posix.fs.tls:
#     filter: CONFIG_ARCH_HAS_THREAD_LOCAL_STORAGE and CONFIG_TOOLCHAIN_SUPPORTS_THREAD_LOCAL_STORAGE
#     extra_configs:
#       - CONFIG_NEWLIB_LIBC=n
#       - CONFIG_THREAD_LOCAL_STORAGE=y
#     integration_platforms:
#       - qemu_x86
#   portability.posix.fs.tls.newlib:
#     filter:
#       TOOLCHAIN_HAS_NEWLIB == 1 and CONFIG_ARCH_HAS_THREAD_LOCAL_STORAGE and
#       CONFIG_TOOLCHAIN_SUPPORTS_THREAD_LOCAL_STORAGE
#     arch_exclude:
#       - posix
#     extra_configs:
#       - CONFIG_NEWLIB_LIBC=y
#       - CONFIG_THREAD_LOCAL_STORAGE=y
#     integration_platforms:
#       - qemu_x86
#   portability.posix.fs.picolibc:
#     tags: picolibc
#     filter: CONFIG_PICOLIBC_SUPPORTED
#     extra_configs:
#       - CONFIG_PICOLIBC=y
#     integration_platforms:
#       - qemu_x86
#   portability.posix.fs.tls.picolibc:
#     tags: picolibc
#     filter: CONFIG_PICOLIBC_SUPPORTED
#     extra_configs:
#       - CONFIG_PICOLIBC=y
#     integration_platforms:
#       - qemu_x86
```

## prj.conf
```kconfig
# CONFIG_SHELL=n
# CONFIG_POSIX_UNAME_SHELL=n
# CONFIG_PICOLIBC=n 
# CONFIG_MINIMAL_LIBC=y

# CONFIG_FILE_SYSTEM_SHELL=y
# CONFIG_FILE_SYSTEM=y
# CONFIG_LOG=y
# CONFIG_FAT_FILESYSTEM_ELM=y
# CONFIG_POSIX_API=n
# CONFIG_POSIX_FS=n
# CONFIG_POSIX_DEVICE_IO=n

# CONFIG_FDTABLE=n

# CONFIG_HEAP_MEM_POOL_SIZE=4096
# CONFIG_COMMON_LIBC_MALLOC_ARENA_SIZE=8192

# # CONFIG_DEBUG_COREDUMP=y
# CONFIG_USERSPACE=y
# # CONFIG_QEMU_EXTRA_FLAGS="-serial tcp:localhost:5678,server"
# # CONFIG_QEMU_GDBSERVER_LISTEN_DEV="tcp::1234"

CONFIG_MINIMAL_LIBC=y
CONFIG_FILE_SYSTEM=y
CONFIG_LOG=y
CONFIG_FAT_FILESYSTEM_ELM=y
CONFIG_POSIX_API=y
CONFIG_POSIX_FILE_SYSTEM=y
CONFIG_MAIN_STACK_SIZE=4096
CONFIG_EVENTFD=n
```

## app.overlay
```dts
/*
 * Copyright (c) 2023 Nordic Semiconductor ASA
 *
 * SPDX-License-Identifier: Apache-2.0
 */

/ {
	ramdisk0 {
		compatible = "zephyr,ram-disk";
		disk-name = "RAM";
		sector-size = <512>;
		sector-count = <160>;
	};
};
```

## src/main.c
```c
// #include<stdio.h>
// #include <string.h>
// #include <signal.h>
// #include <zephyr/fs/fs.h>
// #include <ff.h>

// #define FATFS_MNTP	"/RAM:"
// #define TEST_ROOT	FATFS_MNTP"/"
// #define TEST_FILE	FATFS_MNTP"/testfile.txt"
// #define TEST_DIR	FATFS_MNTP"/testdir"
// #define TEST_DIR_FILE	FATFS_MNTP"/testdir/testfile.txt"
// /* FatFs work area */
// static FATFS fat_fs;

// /* mounting info */
// static struct fs_mount_t fatfs_mnt = {
// 	.type = FS_FATFS,
// 	.mnt_point = FATFS_MNTP,
// 	.fs_data = &fat_fs,
// };

// void test_mount(void)
// {
// 	int res;

// 	res = fs_mount(&fatfs_mnt);
// 	if (res < 0) {
// 		printf("Error mounting fs [%d]\n", res);
// 		/* FIXME: restructure tests as per #46897 */
// 		__ASSERT_NO_MSG(res == 0);
// 	}

// 	return NULL;
// }

// int main () {
//    FILE *fp;
//    char data[] = "Test file\n";
//     char buffer[100];
//    test_mount();

//    fp = fopen( "/RAM:/file.txt" , "w+" );
//    if(fp == NULL) {
//       printf("Unable to open the file\n");
//    } else {
//       printf("Opened the file bruh!\n");
//    }
//     int bytes_written = fwrite(data, sizeof(data[0]), sizeof(data) - 1, fp);

   
//     if (bytes_written != sizeof(data) - 1) {
//         perror("fwrite failed");
//         fs_close(&fp->_fs_file);
//         return 1;
//     }
//    //  fs_close(&fp->file_ref);
//     fs_sync(&fp->_fs_file);
//    //     size_t bytes_read = fread(buffer, 1, sizeof(buffer) - 1, fp);
//    //   buffer[bytes_read] = '\0';
//    FILE* fp2 = fopen("/RAM:/file.txt", "r");
//    printf("Opened the file bruh - 4!\n");
//     if (fp2 == NULL) {
//         perror("fopen failed");
//         return 1;
//     }
//     size_t bytes_read = fread(buffer, 1, sizeof(buffer) - 1, fp2);
//      buffer[bytes_read] = '\0';

//    //  // Print the read data
//     printf("Read data: %s - %d\n", buffer, bytes_read);


// // 	fs_close(&file);
  
//    return(0);
// }





#include<stdio.h>

int main()
{
    printf("Hello1");
    fprintf(stdin, "Hello");
    fputc('c', stdout);
    return 0;
}
```
