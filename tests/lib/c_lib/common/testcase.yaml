## tests/lib/c_lib/common/testcase.yaml
```yaml
common:
  tags:
    - clib
  ignore_faults: true
  integration_platforms:
    - mps2/an385
tests:
  libraries.libc.common: {}
  libraries.libc.common.minimal:
    filter: CONFIG_MINIMAL_LIBC_SUPPORTED
    tags: minimal_libc
    extra_configs:
      - CONFIG_MINIMAL_LIBC=y
      - CONFIG_MINIMAL_LIBC_NON_REENTRANT_FUNCTIONS=y
      - CONFIG_MINIMAL_LIBC_RAND=y
  libraries.libc.common.minimal.stdio:
    filter: CONFIG_MINIMAL_LIBC_SUPPORTED
    tags: minimal_libc_stdio
    integration_platforms:
      - qemu_x86
    min_ram: 32
    extra_configs:
      - CONFIG_MINIMAL_LIBC=y
      - CONFIG_PICOLIBC=n
      - CONFIG_FILE_SYSTEM=y
      - CONFIG_LOG=y
      - CONFIG_FAT_FILESYSTEM_ELM=y
      - CONFIG_POSIX_API=y
      - CONFIG_POSIX_FS=y
      - CONFIG_HEAP_MEM_POOL_SIZE=4096
      - CONFIG_COMMON_LIBC_MALLOC_ARENA_SIZE=8192
  libraries.libc.common.newlib:
    filter: CONFIG_NEWLIB_LIBC_SUPPORTED
    min_ram: 32
    tags: newlib
    extra_configs:
      - CONFIG_NEWLIB_LIBC=y
  libraries.libc.common.newlib_nano:
    filter: CONFIG_NEWLIB_LIBC_SUPPORTED and CONFIG_HAS_NEWLIB_LIBC_NANO
    tags: newlib
    extra_configs:
      - CONFIG_NEWLIB_LIBC=y
      - CONFIG_NEWLIB_LIBC_NANO=y
  libraries.libc.common.picolibc:
    filter: CONFIG_PICOLIBC_SUPPORTED
    tags: picolibc
    extra_configs:
      - CONFIG_PICOLIBC=y
  libraries.libc.common.picolibc.module:
    filter: CONFIG_ZEPHYR_PICOLIBC_MODULE
    tags: picolibc
    extra_configs:
      - CONFIG_PICOLIBC=y
      - CONFIG_PICOLIBC_USE_MODULE=y
  libraries.libc.common.picolibc.notls:
    filter: CONFIG_ZEPHYR_PICOLIBC_MODULE
    tags: picolibc
    extra_configs:
      - CONFIG_PICOLIBC=y
      - CONFIG_PICOLIBC_USE_MODULE=y
      - CONFIG_THREAD_LOCAL_STORAGE=n
```
